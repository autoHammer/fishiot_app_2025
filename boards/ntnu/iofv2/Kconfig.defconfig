## boards/ntnu/iofv2/Kconfig.defconfig
```kconfig
if BOARD_IOFV2_NRF9160_NS

config BOARD_IOFV2
	select USE_DT_CODE_PARTITION if BOARD_IOFV2_NRF9160_NS

endif # BOARD_IOFV2_NRF9160_NS
```

## boards/ntnu/iofv2/board.yml
```yaml
board:
  name: iofv2
  vendor: ntnu
  socs:
  - name: nrf9160
    variants:
    - name: ns
```
